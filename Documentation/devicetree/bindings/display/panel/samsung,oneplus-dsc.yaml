## Documentation/devicetree/bindings/display/panel/samsung,oneplus-dsc.yaml
```yaml
# SPDX-License-Identifier: GPL-2.0-only OR BSD-2-Clause
%YAML 1.2
---
$id: http://devicetree.org/schemas/display/panel/samsung,oneplus-dsc.yaml#
$schema: http://devicetree.org/meta-schemas/core.yaml#

title: Samsung 1440x3120 DSC AMOLED panel of the OnePlus 7 Pro and 7T Pro

description:
  A 1440x3120 AMOLED panel in DSI command mode with DSC 1.1, two 720-pixel
  slices per line sent in one packet, as OnePlus's downstream kernel
  describes it (dsi_samsung_oneplus_dsc_cmd).

maintainers:
  - johannSo <jzeug@soppa.de>

allOf:
  - $ref: panel-common.yaml#

properties:
  compatible:
    const: samsung,oneplus-dsc

  reg:
    maxItems: 1

  vddio-supply:
    description: I/O supply (1.8 V)

  reset-gpios: true
  port: true

required:
  - compatible
  - reg
  - vddio-supply
  - reset-gpios
  - port

unevaluatedProperties: false

examples:
  - |
    #include <dt-bindings/gpio/gpio.h>

    dsi {
        #address-cells = <1>;
        #size-cells = <0>;

        panel@0 {
            compatible = "samsung,oneplus-dsc";
            reg = <0>;

            vddio-supply = <&vreg_l14a_1p8>;
            reset-gpios = <&tlmm 6 GPIO_ACTIVE_LOW>;

            port {
                panel_in: endpoint {
                    remote-endpoint = <&mdss_dsi0_out>;
                };
            };
        };
    };
...
```

## Documentation/devicetree/bindings/input/awinic,aw8695.yaml
```yaml
# SPDX-License-Identifier: (GPL-2.0-only OR BSD-2-Clause)
%YAML 1.2
---
$id: http://devicetree.org/schemas/input/awinic,aw8695.yaml#
$schema: http://devicetree.org/meta-schemas/core.yaml#

title: Awinic AW8695 and AW8697 LRA haptics drivers

maintainers:
  - Dmitry Torokhov <dmitry.torokhov@gmail.com>

description:
  I2C haptics drivers for a linear resonant actuator (LRA), with a waveform
  RAM, a boost converter and resonant frequency detection. The AW8697 has
  the AW8695's register map and a different chip ID.

properties:
  compatible:
    enum:
      - awinic,aw8695
      - awinic,aw8697

  reg:
    maxItems: 1

  interrupts:
    maxItems: 1

  reset-gpios:
    maxItems: 1

  awinic,f0-hz:
    description:
      Resonant frequency of the actuator, in Hz. The chip measures it at
      probe; a measurement far from this value is not used.
    minimum: 50
    maximum: 500

required:
  - compatible
  - reg
  - awinic,f0-hz

additionalProperties: false

examples:
  - |
    #include <dt-bindings/gpio/gpio.h>
    #include <dt-bindings/interrupt-controller/irq.h>

    i2c {
        #address-cells = <1>;
        #size-cells = <0>;

        vibrator@5a {
            compatible = "awinic,aw8697";
            reg = <0x5a>;
            interrupts-extended = <&tlmm 24 IRQ_TYPE_EDGE_FALLING>;
            reset-gpios = <&tlmm 116 GPIO_ACTIVE_LOW>;
            awinic,f0-hz = <170>;
        };
    };
```

## Documentation/devicetree/bindings/media/i2c/onnn,lc898217xc.yaml
```yaml
# SPDX-License-Identifier: (GPL-2.0-only OR BSD-2-Clause)
%YAML 1.2
---
$id: http://devicetree.org/schemas/media/i2c/onnn,lc898217xc.yaml#
$schema: http://devicetree.org/meta-schemas/core.yaml#

title: ON Semiconductor LC898217XC camera lens autofocus actuator driver

maintainers:
  - johannSo <jzeug@soppa.de>

description:
  The LC898217XC drives a camera module's voice coil focus actuator. It is
  controlled over I2C with 8-bit register addresses and takes a 10-bit
  target position. The OnePlus 7T Pro's main and telephoto modules from
  one of their makers focus with one each.

properties:
  compatible:
    const: onnn,lc898217xc

  reg:
    maxItems: 1

  vdd-supply:
    description: Actuator supply.

  vio-supply:
    description: Interface (I2C pull-up) supply.

required:
  - compatible
  - reg
  - vdd-supply
  - vio-supply

additionalProperties: false

examples:
  - |
    i2c {
        #address-cells = <1>;
        #size-cells = <0>;

        lens@72 {
            compatible = "onnn,lc898217xc";
            reg = <0x72>;
            vdd-supply = <&cam_main_vaf>;
            vio-supply = <&vreg_l1c_1p8>;
        };
    };
...
```

## Documentation/devicetree/bindings/media/i2c/sony,imx471.yaml
```yaml
# SPDX-License-Identifier: (GPL-2.0-only OR BSD-2-Clause)
%YAML 1.2
---
$id: http://devicetree.org/schemas/media/i2c/sony,imx471.yaml#
$schema: http://devicetree.org/meta-schemas/core.yaml#

title: Sony IMX471 Sensor

maintainers:
  - Kate Hsuan <hpa@redhat.com>

description:
  The Sony IMX471 is a 16 MP CMOS image sensor with an active array of
  4656H x 3496V, controlled over I2C (CCI) and sending images over a
  four-lane MIPI CSI-2 D-PHY link.

allOf:
  - $ref: /schemas/media/video-interface-devices.yaml#

properties:
  compatible:
    const: sony,imx471

  reg:
    maxItems: 1

  clocks:
    description: The external clock (INCK), 19.2 MHz.
    maxItems: 1

  vana-supply:
    description: Analog supply (2.8 V).

  vdig-supply:
    description: Digital core supply (1.05 V).

  vif-supply:
    description: Interface supply (1.8 V).

  reset-gpios:
    description: The XCLR pin, active low.
    maxItems: 1

  port:
    $ref: /schemas/graph.yaml#/$defs/port-base
    additionalProperties: false

    properties:
      endpoint:
        $ref: /schemas/media/video-interfaces.yaml#
        unevaluatedProperties: false

        properties:
          data-lanes:
            items:
              - const: 1
              - const: 2
              - const: 3
              - const: 4

          link-frequencies: true

        required:
          - data-lanes
          - link-frequencies

    required:
      - endpoint

required:
  - compatible
  - reg
  - clocks
  - port

unevaluatedProperties: false

examples:
  - |
    #include <dt-bindings/gpio/gpio.h>

    i2c {
        #address-cells = <1>;
        #size-cells = <0>;

        camera@1a {
            compatible = "sony,imx471";
            reg = <0x1a>;
            clocks = <&cam_mclk2>;
            vana-supply = <&front_cam_vana>;
            vdig-supply = <&front_cam_vdig>;
            vif-supply = <&front_cam_vif>;
            reset-gpios = <&tlmm 12 GPIO_ACTIVE_LOW>;
            rotation = <270>;
            orientation = <0>;

            port {
                endpoint {
                    remote-endpoint = <&csiphy2_ep>;
                    data-lanes = <1 2 3 4>;
                    link-frequencies = /bits/ 64 <200000000>;
                };
            };
        };
    };
...
```

## Documentation/devicetree/bindings/media/i2c/sony,imx586.yaml
```yaml
# SPDX-License-Identifier: (GPL-2.0-only OR BSD-2-Clause)
%YAML 1.2
---
$id: http://devicetree.org/schemas/media/i2c/sony,imx586.yaml#
$schema: http://devicetree.org/meta-schemas/core.yaml#

title: Sony IMX481 and IMX586 sensors with register tables from firmware

maintainers:
  - johannSo <jzeug@soppa.de>

description:
  The Sony IMX586 (48 MP, 8000x6000 quad-Bayer) and IMX481 (16 MP,
  4656x3496) CMOS image sensors, controlled over I2C (CCI) and sending
  images over MIPI CSI-2 (D-PHY, or C-PHY on some IMX586 modules). Their
  initialisation and mode settings are loaded from the firmware file named
  by firmware-name; the modes whose link frequency is not listed in the
  endpoint are not offered.

allOf:
  - $ref: /schemas/media/video-interface-devices.yaml#

properties:
  compatible:
    enum:
      - sony,imx481
      - sony,imx586

  reg:
    maxItems: 1

  clocks:
    description: The external clock (INCK), at the rate the tables expect.
    maxItems: 1

  firmware-name:
    maxItems: 1
    description: The register table file.

  vana-supply:
    description: Analogue supply.

  vana2-supply:
    description: A second analogue switch, enabled after vana.

  vdig-supply:
    description: Digital core supply.

  vdig2-supply:
    description: A second digital switch, enabled after vdig.

  vif-supply:
    description: Interface supply (1.8 V), enabled last.

  reset-gpios:
    description: The XCLR pin, active low.
    maxItems: 1

  port:
    $ref: /schemas/graph.yaml#/$defs/port-base
    additionalProperties: false

    properties:
      endpoint:
        $ref: /schemas/media/video-interfaces.yaml#
        unevaluatedProperties: false

        properties:
          bus-type:
            enum:
              - 1 # MEDIA_BUS_TYPE_CSI2_CPHY
              - 4 # MEDIA_BUS_TYPE_CSI2_DPHY

          data-lanes:
            minItems: 1
            maxItems: 4

          link-frequencies: true

        required:
          - data-lanes
          - link-frequencies

    required:
      - endpoint

required:
  - compatible
  - reg
  - clocks
  - firmware-name
  - reset-gpios
  - port

unevaluatedProperties: false

examples:
  - |
    #include <dt-bindings/gpio/gpio.h>

    i2c {
        #address-cells = <1>;
        #size-cells = <0>;

        camera@1a {
            compatible = "sony,imx586";
            reg = <0x1a>;
            clocks = <&cam_mclk1>;
            firmware-name = "omamobile/sony-imx586.bin";
            vana-supply = <&cam_main_vana>;
            vdig-supply = <&cam_main_vdig>;
            vif-supply = <&cam_vio>;
            reset-gpios = <&tlmm 30 GPIO_ACTIVE_LOW>;
            orientation = <1>;
            rotation = <90>;

            port {
                endpoint {
                    remote-endpoint = <&csiphy1_ep>;
                    data-lanes = <1 2 3 4>;
                    link-frequencies = /bits/ 64 <600000000>;
                };
            };
        };
    };
...
```

## Documentation/devicetree/bindings/misc/goodix,g7-udfps.yaml
```yaml
# SPDX-License-Identifier: (GPL-2.0-only OR BSD-2-Clause)
%YAML 1.2
---
$id: http://devicetree.org/schemas/misc/goodix,g7-udfps.yaml#
$schema: http://devicetree.org/meta-schemas/core.yaml#

title: Goodix optical under-display fingerprint sensor (secure world bus)

maintainers:
  - Derek Ross <derekross@gmail.com>

description:
  Goodix optical fingerprint sensor under an OLED panel, as in the Google
  Pixel 7 Pro and the OnePlus 7T Pro. Its SPI bus is owned by a trusted
  application in the secure world (Trusty on the Pixel, QSEE on the OnePlus),
  so the node is not on an SPI controller; it describes only the lines the
  application processor drives.

properties:
  compatible:
    enum:
      - goodix,g7-udfps
      - oneplus,hotdog-udfps

  interrupts:
    maxItems: 1
    description: Sensor event line (rising edge).

  reset-gpios:
    maxItems: 1

  vdd-supply:
    description: Sensor analog supply.

  clocks:
    description:
      Clocks of the SPI controller the secure world drives the sensor
      through, which only the application processor can turn on. They are
      kept on while the sensor is powered.
    maxItems: 3

  clock-names:
    items:
      - const: se
      - const: m-ahb
      - const: s-ahb

required:
  - compatible
  - interrupts
  - reset-gpios

dependentRequired:
  clocks: [ clock-names ]

additionalProperties: false

examples:
  - |
    #include <dt-bindings/gpio/gpio.h>
    #include <dt-bindings/interrupt-controller/irq.h>

    fingerprint {
        compatible = "goodix,g7-udfps";
        interrupt-parent = <&gpa9>;
        interrupts = <2 IRQ_TYPE_EDGE_RISING>;
        reset-gpios = <&gpp1 1 GPIO_ACTIVE_LOW>;
    };
  - |
    #include <dt-bindings/clock/qcom,gcc-sm8150.h>
    #include <dt-bindings/gpio/gpio.h>
    #include <dt-bindings/interrupt-controller/irq.h>

    fingerprint {
        compatible = "oneplus,hotdog-udfps";
        interrupts-extended = <&tlmm 118 IRQ_TYPE_EDGE_RISING>;
        reset-gpios = <&tlmm 131 GPIO_ACTIVE_LOW>;
        clocks = <&gcc GCC_QUPV3_WRAP0_S3_CLK>,
                 <&gcc GCC_QUPV3_WRAP_0_M_AHB_CLK>,
                 <&gcc GCC_QUPV3_WRAP_0_S_AHB_CLK>;
        clock-names = "se", "m-ahb", "s-ahb";
    };
```

## Documentation/devicetree/bindings/soc/qcom/oneplus,sm8150-project-info.yaml
```yaml
# SPDX-License-Identifier: (GPL-2.0-only OR BSD-2-Clause)
%YAML 1.2
---
$id: http://devicetree.org/schemas/soc/qcom/oneplus,sm8150-project-info.yaml#
$schema: http://devicetree.org/meta-schemas/core.yaml#

title: OnePlus SM8150 project info for the modem

maintainers:
  - johannSo <jzeug@soppa.de>

description:
  OnePlus's bootloader on the OnePlus 7 series leaves a project info item
  in SMEM (item 136) that the modem reads. OnePlus's kernel completes it
  with the state of the phone's RF test cable detection; without it the
  modem assumes cables are plugged into its RF test connectors.

properties:
  compatible:
    const: oneplus,sm8150-project-info

  oneplus,rf-cable-state:
    $ref: /schemas/types.yaml#/definitions/uint32
    enum: [0, 1]
    default: 1
    description:
      The RF test cable state to report, 1 for no cable plugged in.

required:
  - compatible

additionalProperties: false

examples:
  - |
    project-info {
        compatible = "oneplus,sm8150-project-info";
    };
...
```
